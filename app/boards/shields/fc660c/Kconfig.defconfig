## app/boards/shields/fc660c/Kconfig.defconfig
```kconfig
# Copyright (c) 2020 Pete Johanson, Richard Jones
# SPDX-License-Identifier: MIT

if SHIELD_FC660C

config ZMK_KEYBOARD_NAME
	default "FC660C"

endif
```

## app/boards/shields/fc660c/Kconfig.shield
```kconfig
# Copyright (c) 2020 Pete Johanson, Richard Jones
# SPDX-License-Identifier: MIT

config SHIELD_FC660C
	def_bool $(shields_list_contains,fc660c)
```

## app/drivers/zephyr/dts/bindings/kscan/zmk,kscan-gpio-topre.yaml
```yaml
# Copyright (c) 2020, The ZMK Contributors
# SPDX-License-Identifier: MIT

description: GPIO keyboard topre controller

compatible: "zmk,kscan-gpio-topre"

include: kscan.yaml

properties:
  row-gpios:
    type: phandle-array
    required: true
  col-gpios:
    type: phandle-array
    required: true
  col-select-gpios:
    type: phandle-array
    required: true
  enable-gpios:
    type: phandle-array
    required: true
  hys-gpios:
    type: phandle-array
    required: true
  key-gpios:
    type: phandle-array
    required: true
  led-gpios:
    type: phandle-array
    required: true
  max-row: # limit the rows queried, many keyboards don't use all the rows, 0 does all
    type: int
    default: 0
  active-polling-interval-msec:
    type: int
    default: 10
  idle-polling-interval-msec:
    type: int
    default: 30
  sleep-polling-interval-msec:
    type: int
    default: 200
```
